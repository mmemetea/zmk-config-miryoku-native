/*
 * Seth's Corne-ish Zen config
 * Uses a modified version of [the Pnohty layout](https://github.com/rayduck/pnohty).
 *
 *
 * COMBOS
 * ╭──────────────╮     ╭──────────────╮
 * │ 0  1  2  3  4│     │ 5  6  7  8  9│
 * │10 11 12 13 14│     │15 16 17 18 19│
 * │20 21 22 23 24╰─╮ ╭─╯25 26 27 28 29│
 * ╰───────╮30 31 32│ │33 34 35╭───────╯
 *         ╰────────╯ ╰────────╯
 *   1 & 2  - DEL
 *  21 & 22 - TAB
 *  31 & 24 - ALT
 *                    7 & 8  - ENTER
 *                   25 & 34 - GUI
 */

#include <behaviors.dtsi>
#include <dt-bindings/zmk/keys.h>
#include <dt-bindings/zmk/bt.h>
#include <dt-bindings/zmk/outputs.h>

#define DEF 0
#define GAM 1
#define SYM 2
#define NUM 3
#define FUN 4
#define NAV 5
#define SET 6

/ {
    chosen {
        zmk,physical-layout = &foostan_corne_5col_layout;
    };

    // Definitions of homerow mods
    behaviors {
        hm: homerow_tap_preferred_mods {
            compatible = "zmk,behavior-hold-tap";
            #binding-cells = <2>;
            tapping-term-ms = <200>;
            quick-tap-ms = <0>;
            flavor = "tap-preferred";
            bindings = <&kp>, <&kp>;
        };
    };

    combos {
        compatible = "zmk,combos";
        
        // W + F = TAB
        combo_wf_tab {
            layers = <0 1 2 3 4 5 6>;
            timeout-ms = <50>;
            key-positions = <1 2>;
            bindings = <&kp TAB>;
        };

        // X + C = DEL
        combo_xc_delete {
            layers = <0 1 2 3 4 5>;
            timeout-ms = <50>;
            key-positions = <21 22>;
            bindings = <&kp DEL>;
        };

        // SYM + B = ALT
        combo_alt {
            layers = <0 1 2 3 4 5 6>;
            timeout-ms = <50>;
            key-positions = <24 31>;
            bindings = <&kp LALT>;
        };

        // NUM + K = LGUI
        combo_gui {
            layers = <0 1 2 3 4 5>;
            timeout-ms = <50>;
            key-positions = <25 34>;
            bindings = <&kp LGUI>;
        };

        // U + Y = RETURN
        combo_uy_ret {
            layers = <0 1 2 3 4 5 6>;
            timeout-ms = <50>;
            key-positions = <7 8>;
            bindings = <&kp RET>;
        };
    };
};

/ {
    keymap {
        compatible = "zmk,keymap";
        default_layer {
            display-name = "DEF";
            bindings = <
                &kp Q       &kp W       &kp F         &kp P        &kp B           &kp J          &kp L         &kp U          &kp Y        &kp &
                &kp A       &kp R       &kp S         &kp T        &kp G           &kp M          &kp N         &kp E          &kp I        &kp O
                &kp Z       &kp X       &kp C         &kp D        &kp V           &kp K          &kp H         &kp ,          &kp .      &kp /
                                        &kp LCTRL      &lt SYM      &kp LSHIFT        &kp SPACE      &lt BSPC  &kp DEL
            >;
        };
        gaming_layer {
            display-name = "GAM";
            bindings = <
                &kp Q    &kp W  &kp E     &kp R     &kp T           &kp Y      &kp U   &kp I      &kp O    &kp P
                &kp A    &kp S  &kp D     &kp F     &kp G           &kp H      &kp J   &kp K      &kp L    &kp &
                &kp Z    &kp X  &kp C     &kp V     &kp B           &kp N      &kp M   &kp ,      &kp .  &kp /
                                &kp LCTRL  &lt GSYM  &kp SPACE       &trans   &trans   &trans
            >;
        };
        symbol_layer {
            display-name = "SYM";
            bindings = <
                &kp ESC   &kp \      &kp %      &kp ^      &trans   &trans     &kp ^      &kp [      &kp ]      &kp RET
                &kp *      &kp (      &kp )      &kp :      &trans   &trans     &kp '      &kp {      &kp }      &lt RET
                &kp ~      &kp `      &kp |      &kp +      &trans   &trans     &kp #      &kp <      &kp >      &kp DEL
                                    &trans     &trans    &kp LSFT &kp SPACE  &kp ESC   &trans
            >;
        };
        number_layer {
            display-name = "NUM";
            bindings = <
                &kp ESC    &kp 4  &kp 5  &kp 6 &trans   &trans      &kp |      &kp -      &kp /      &kp &
                &kp (      &kp 1  &kp 2  &kp 3 &trans   &trans      &kp )      &kp _      &kp =      &lt NUM
                &kp ~      &kp 7  &kp 8  &kp 9 &trans   &trans      &kp +      &kp ?      &kp !      &kp DEL
                                   &kp . &kp 0 &kp LSHIFT      &kp SPACE  &trans    &trans
            >;
        };
        function_layer {
            display-name = "FUN";
            bindings = <
                &trans    &kp F6  &kp F5  &kp F4  &kp F10         &bt BT_SEL 0 &bt BT_SEL 1  &out OUT_USB  &out OUT_BLE  &trans
                &kp CAPS &kp F3  &kp F2  &kp F1  &kp F11         &kp K_MUTE   &kp C_VOL_DN  &kp C_VOL_UP  &kp C_BRI_DN  &kp C_BRI_UP
                &trans   &kp F9  &kp F8  &kp F7  &kp F12         &trans        &trans         &trans         &lt DANGER    &trans
                             &trans  &trans  &kp LSHIFT        &trans       &trans        &trans 
            >;
        };
        navigation_layer {
            display-name = "NAV";
            bindings = <
                &trans     &trans     &trans     &trans     &trans         &kp DOWN   &kp RIGHT  &trans      &trans      &trans
                &kp LSHIFT  &kp LCTRL  &kp LALT  &kp LGUI  &trans         &kp LEFT   &kp DOWN   &kp UP     &kp RIGHT  &trans
                &trans     &trans     &trans     &trans     &trans         &kp UP     &kp PG_DN  &kp PG_UP  &kp END    &trans
                            &trans     &trans     &kp LSHIFT      &kp SPACE  &trans      &trans
            >;
        };
        settings_layer {
            display-name = "SET";
            bindings = <
                &trans  &trans &trans &trans  &trans      &trans      &trans  &trans &trans  &trans
                &trans  &trans &trans &trans  &trans      &trans      &trans  &trans &trans  &trans
                &trans &trans &trans &trans  &trans      &bt BT_CLR &sys_reset &trans &trans &trans
                         &trans &trans &trans      &trans      &trans  &trans 
            >;
        };
        lower_layer {
            display-name = "LOW";
            bindings = <
                &kp LSHFT  &kp Z   &kp X    &kp C    &kp V     &kp B     &kp LBKT        &kp RBKT  &kp N     &kp M     &kp ,      &kp .      &kp /      &kp &
                &mo ADJUST &kp ESC &kp LALT &kp LGUI &kp LANG2 &mo LOWER &kp SPACE       &kp SPACE &mo RAISE &kp LANG1 &kp LEFT  &kp DOWN   &kp UP    &kp RIGHT
                        >;
        };
        raise_layer {
            display-name = "RAI";
            bindings = <
                &kp LSHFT  &kp ~   &kp !   &kp @    &kp #     &kp $     &kp %     &kp ^      &kp &      &kp *      &kp (      &kp )      &kp &
                &mo ADJUST &kp `   &kp 1   &kp 2    &kp 3     &mo LOWER &kp SPACE       &kp SPACE &mo RAISE &kp 4     &kp 5     &kp 6     &kp /
                        >;
        };
        symbol_layer {
            display-name = "SYM";
            bindings = <
                &kp ESC   &kp \      &kp %      &kp ^      &trans   &trans     &kp ^      &kp [      &kp ]      &kp &
                &kp *      &kp (      &kp )      &kp :      &trans   &trans     &kp '      &kp {      &kp }      &lt &
                &kp ~      &kp `      &kp |      &kp +      &trans   &trans     &kp #      &kp <      &kp >      &kp DEL
                                    &trans     &trans    &kp LSFT &kp SPACE  &kp ESC   &trans
            >;
        };
        number_layer {
            display-name = "NUM";
            bindings = <
                &kp ESC    &kp 4  &kp 5  &kp 6 &trans   &trans      &kp |      &kp -      &kp /      &kp &
                &kp (      &kp 1  &kp 2  &kp 3 &trans   &trans      &kp )      &kp _      &kp =      &lt &
                &kp ~      &kp 7  &kp 8  &kp 9 &trans   &trans      &kp +      &kp ?      &kp !      &kp DEL
                                   &kp . &kp 0 &kp LSHIFT      &kp SPACE  &trans    &trans
            >;
        };
    };
};